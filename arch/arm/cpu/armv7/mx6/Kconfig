## arch/arm/cpu/armv7/mx6/Kconfig
```kconfig
if ARCH_MX6 || SECO_SYSTEM

config MX6
	bool
	default y

config MX6D
	bool

config MX6DL
	bool

config MX6Q
	bool

config MX6QP
        bool
config MX6QDL
	bool

config MX6S
	bool

config MX6SL
	bool

config MX6SX
	bool

config MX6UL
	bool

endif
```

## board/seco/Kconfig
```kconfig
if TARGET_MX6SECO_Q7_928 || TARGET_MX6SECO_UQ7_962 || TARGET_MX6SECO_USBC_A62 || TARGET_MX6SECO_USBC_984 || TARGET_MX6SECO_UQ7_J_A75


config SYS_SOC
	default "mx6"


config SYS_VENDOR
	default "seco"


config SYS_BOARD
	default "quadmo747_928"   if TARGET_MX6SECO_Q7_928
	default "uq7_962"         if TARGET_MX6SECO_UQ7_962
	default "uq7-j_A75"       if TARGET_MX6SECO_UQ7_J_A75
	default "SBC_A62"         if TARGET_MX6SECO_USBC_A62
	default "SBC_984"         if TARGET_MX6SECO_USBC_984



choice
	prompt "SECO i.MX6 SoC variant"

	config SECOMX6QP
                bool "i.MX6QP"
                select MX6QP

	config SECOMX6Q
		bool "i.MX6Q"
		select MX6Q

	config SECOMX6DL
		bool "i.MX6DL"
		select MX6DL

	config SECOMX6S
		bool "i.MX6S"
		select MX6S

endchoice

choice
        prompt "SECO i.MX6 save device"

        config ENV_MMC
                bool "env on the eMMC"

        config ENV_SPI
                bool "env on the SPI"

        config ENV_SATA
                bool "env on the SATA "

endchoice


choice
	prompt "DDR size"

	config SECOMX6_256MB_1x256
		bool "256MB (1x256MB)"

	config SECOMX6_512MB_2x256
		bool "512MB (2x256MB)"

	config SECOMX6_1GB_2x512
		bool "1GB (2x512MB)"

	config SECOMX6_1GB_4x256
		bool "1GB (4x256MB)"

	config SECOMX6_2GB_4x512
		bool "2GB (4x512MB)"

	config SECOMX6_4GB_8x512
		bool "4GB (8x512MB)"

endchoice


config SYS_CONFIG_NAME
	default "mx6seco_quadmo747_928"   if TARGET_MX6SECO_Q7_928
	default "mx6seco_uq7_962"         if TARGET_MX6SECO_UQ7_962
	default "mx6seco_uq7-j_A75"       if TARGET_MX6SECO_UQ7_J_A75
	default "mx6seco_SBC_A62"         if TARGET_MX6SECO_USBC_A62
	default "mx6seco_SBC_984"         if TARGET_MX6SECO_USBC_984


config IMX_CONFIG
	default "board/seco/ddr/mx6_quadmo747_928_ram.cfg"   if TARGET_MX6SECO_Q7_928
	default "board/seco/ddr/mx6_uq7_962_ram.cfg"         if TARGET_MX6SECO_UQ7_962
	default "board/seco/ddr/mx6_uq7-j_A75_ram.cfg"       if TARGET_MX6SECO_UQ7_J_A75
	default "board/seco/ddr/mx6_SBC_A62_ram.cfg"         if TARGET_MX6SECO_USBC_A62
	default "board/seco/ddr/mx6_SBC_984_ram.cfg"         if TARGET_MX6SECO_USBC_984


config DEFAULT_FDT_FILE
	string
	default "imx6q-seco_quadmo747_928.dtb"    if TARGET_MX6SECO_Q7_928 && SECOMX6Q
	default "imx6qp-seco_quadmo747_928.dtb"	  if TARGET_MX6SECO_Q7_928 && SECOMX6QP
	default "imx6q-seco_uq7_962.dtb"          if TARGET_MX6SECO_UQ7_962 && SECOMX6Q
	default "imx6q-seco_uq7-j_A75.dtb"        if TARGET_MX6SECO_UQ7_J_A75 && SECOMX6Q
	default "imx6q-seco_SBC_A62.dtb"	  if TARGET_MX6SECO_USBC_A62 && SECOMX6Q
	default "imx6q-seco_SBC_984.dtb"	  if TARGET_MX6SECO_USBC_984 && SECOMX6Q
	default "imx6qp-seco_SBC_A62.dtb"	  if TARGET_MX6SECO_USBC_A62 && SECOMX6QP
	default "imx6dl-seco_quadmo747_928.dtb"   if TARGET_MX6SECO_Q7_928 && (SECOMX6DL || SECOMX6S)
	default "imx6dl-seco_uq7_962.dtb"         if TARGET_MX6SECO_UQ7_962 && (SECOMX6DL || SECOMX6S)
	default "imx6dl-seco_uq7-j_A75.dtb"       if TARGET_MX6SECO_UQ7_J_A75 && (SECOMX6DL || SECOMX6S)
	default "imx6dl-seco_SBC_A62.dtb"         if TARGET_MX6SECO_USBC_A62 && (SECOMX6DL || SECOMX6S)
	default "imx6dl-seco_SBC_984.dtb"         if TARGET_MX6SECO_USBC_984 && (SECOMX6DL || SECOMX6S)
	


endif
```

## configs/secomx6_SBC_defconfig
```kconfig
CONFIG_ARM=y
CONFIG_SECOMX6Q=y
CONFIG_TARGET_MX6SECO_USBC_A62=y
CONFIG_DM=y
CONFIG_DM_THERMAL=y

CONFIG_CMD_SECO_CONFIG=y
```

## configs/secomx6_q7_defconfig
```kconfig
CONFIG_ARM=y
CONFIG_SECOMX6Q=y
CONFIG_TARGET_MX6SECO_Q7_928=y
CONFIG_DM=y
CONFIG_DM_THERMAL=y

CONFIG_CMD_SECO_CONFIG=y
```

## configs/secomx6_uq7_j_defconfig
```kconfig
CONFIG_ARM=y
CONFIG_SECOMX6Q=y
CONFIG_TARGET_MX6SECO_UQ7_J_A75=y
CONFIG_DM=y
CONFIG_DM_THERMAL=y

CONFIG_CMD_SECO_CONFIG=y
```
